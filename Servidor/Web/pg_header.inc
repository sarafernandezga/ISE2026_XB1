<div align=center style="width: 833; min-height: 470">
<table style="border: 1px solid #006699; border-radius: 8px; overflow: hidden" height=384 cellSpacing=0 cellPadding=0 width="815">
 <tbody>

 <tr bgColor=#006699>
  <td colSpan=5 align=center vAlign=center noWrap height=80>
   <h2 align="center" style="margin: 8px">
    <font face="verdana" color="#ffffff">Comedero inteligente</font>
   </h2>
   <p align="center" style="margin: 4px">
    <font face="verdana" size="2" color="#e6f3ff">
     Monitorizacion y control del sistema de alimentacion
    </font>
   </p>
  </td>
 </tr>

 <tr>
  <td colSpan=5 height=380 width="815" vAlign=top bgColor=#f4f8fb>
   <div align=center>
    <center><font face="verdana">
     <table width="90%" border=0 align=center>
      <tbody><tr>
       <td width="95%">